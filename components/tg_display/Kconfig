## components/tg_display/Kconfig
```kconfig
menu "TinyGate OLED"
    config TG_DISPLAY_SDA_GPIO
        int "OLED SDA GPIO"
        default 20
        range 0 30
    config TG_DISPLAY_SCL_GPIO
        int "OLED SCL GPIO"
        default 19
        range 0 30
    config TG_DISPLAY_ADDRESS
        int "7-bit address (0: probe 0x3C then 0x3D)"
        default 0
        range 0 127
endmenu
```

## components/tg_zigbee/Kconfig
```kconfig
menu "TinyGate Zigbee"
    config TG_ZIGBEE_CHANNEL
        int "Initial Zigbee channel (both boards must agree)"
        range 11 26
        default 15
endmenu
```
